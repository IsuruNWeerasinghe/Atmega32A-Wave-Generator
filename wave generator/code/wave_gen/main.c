#define F_CPU 8000000UL

#include <avr/io.h>
#include <util/delay.h>
#include <avr/interrupt.h>
#include "lcd/LCD16x2_4bit.h"

void sineWave(int tim);
void triWave(int tim);
void squareWave(int tim);
void initModeSw(void);
unsigned int waveLength();

void initADC(unsigned char adchan);
unsigned int  readADC(void);

int sin8bit[] = {0b01111111, 0b10000001, 0b10000011, 0b10000110, 0b10001000, 0b10001010, 0b10001100, 0b10001111, 0b10010001, 0b10010011, 0b10010101, 0b10010111, 0b10011010,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 0b01111011, 0b01111101};
int tri8bit[] = {0b00000000, 0b00000001, 0b00000010, 0b00000100, 0b00000101, 0b00000111, 0b00001000, 0b00001001, 0b00001011, 0b00001100, 0b00001110, 0b00001111, 0b00010001,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 0b00000010, 0b00000001};
int mode = 0;
unsigned int val,val2,waveL;
char dispVal[10];
volatile uint8_t count;

int main(void){
	DDRC = 0xff;
	initModeSw();
	initADC(7);
	lcdinit();
	lcd_clear();
	lcd_gotoxy(0,0);
	lcd_print("Signal Generator");
	lcd_clear();
	
	while (1) {
		waveL = waveLength();		
		if(mode==1){ triWave(waveL);}
		else if(mode==2){ squareWave(waveL);}
		else{ sineWave(waveL);}
	}
}

unsigned int waveLength(){
	val = readADC();
	val2 = (val/1023)*1000000 + 360;
	lcd_gotoxy(0,0);
	lcd_print("Wave Length");
	lcd_gotoxy(0,1);
	lcd_print(itoa(val2,dispVal,10));
	lcd_clear();
	
	return val2;
}

void sineWave(int tim){
	lcd_gotoxy(0,0);
	lcd_print("Sine Wave");
	lcd_clear();
	int t = tim/360;
	for (int i=0; i< 360; i++){
		PORTC = sin8bit[i];
		_delay_us(t);
	}
}

void triWave(int tim){
	lcd_gotoxy(0,0);
	lcd_print("Triangular Wave");
	lcd_clear();
	int t = tim/360;	
	for (int i=0; i< 360; i++){
		PORTC = tri8bit[i];
		_delay_us(t);
	}
}

void squareWave(int tim){
	lcd_gotoxy(0,0);
	lcd_print("Square Wave");
	lcd_clear();
	int t = tim/720;
	PORTC = 0xff;
	_delay_us(t);
	PORTC = 0;
	_delay_us(t);
}

ISR(INT0_vect){
	if (!(PIND & (1<<PIND2))){ mode++;}
	if(mode==3){ mode = 0;}
}

void initModeSw(void){
	DDRD &= ~(1<<INT0);
	GICR = 1<<INT0;
	MCUCR = 0<<ISC01 | 1<<ISC00;
	sei();
}

void initADC(unsigned char adchan){
	DDRA = DDRA &~(1<<7);
	ADMUX = 0;
	ADMUX = ADMUX|1<<REFS0;
	ADMUX= ADMUX|adchan;
	ADCSRA = 0;
	ADCSRA =ADCSRA| 1<<ADEN|1<<ADPS2|1<<ADPS1;
	
}
unsigned int readADC(void){
	ADCSRA = ADCSRA|1<<ADSC;
	while(ADCSRA & (1<<ADSC)){
	}
	return (ADCL|ADCH<<8);
}
